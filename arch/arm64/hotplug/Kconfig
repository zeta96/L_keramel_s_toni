## arch/arm64/hotplug/Kconfig
```kconfig
menu "Custom Hotplug drivers"

config CUSTOM_HOTPLUG
	bool "Enable custom hotplug support"

config ALUCARD_HOTPLUG
        bool "Enable alucard-hotplug cpu hotplug driver"
        default n
        help
          Generic Alucard-hotplug cpu hotplug driver for ARM SOCs 

endmenu
```
